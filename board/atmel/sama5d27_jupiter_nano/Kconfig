## board/atmel/sama5d27_jupiter_nano/Kconfig
```kconfig
if TARGET_SAMA5D27_JUPITER_NANO

config SYS_BOARD
	default "sama5d27_jupiter_nano"

config SYS_VENDOR
	default "atmel"

config SYS_SOC
	default "at91"

config SYS_CONFIG_NAME
	default "sama5d27_jupiter_nano"

endif
```
